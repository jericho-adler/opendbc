BO_ 37 ECM_1: 8 XXX
 SG_ ACCELERATOR_PEDAL_POS : 6|15@0+ (0.00390625,0) [0|32767] "%" XXX

BO_ 117 BUS1_SPEED: 8 XXX
 SG_ BUS1_SPEED : 6|15@0+ (0.0044704,0) [0|32767] "" XXX

BO_ 841 BUS1_CRUISE_CONTROL: 8 XXX
 SG_ CRUISE_CONTROL_ENABLED : 56|1@0+ (1,0) [0|1] "" XXX
 SG_ CRUISE_CONTROL_ENABLED_IDLE_TRAFFIC : 57|1@0+ (1,0) [0|1] "" XXX

CM_ SG_ 117 BUS1_SPEED "m/s";
